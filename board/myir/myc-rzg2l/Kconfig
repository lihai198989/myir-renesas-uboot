## board/myir/myc-rzg2l/Kconfig
```kconfig
if TARGET_MYC_RZG2L 

config SYS_SOC
	default "rmobile"

config SYS_BOARD
	default "myc-rzg2l"

config SYS_VENDOR
	default "myir"

config SYS_CONFIG_NAME
	default "myc-rzg2l"

endif

config SYS_DDR4SIZE
        hex "Size of DDR4"
        default 0x80000000
```

## board/myir/myc-rzg2ul/Kconfig
```kconfig
if TARGET_MYC_RZG2UL

config SYS_SOC
	default "rmobile"

config SYS_BOARD
	default "myc-rzg2ul"

config SYS_VENDOR
	default "myir"

config SYS_CONFIG_NAME
	default "myc-rzg2ul"

endif

config SYS_DDR3SIZE
        hex "Size of DDR3"
        default 0x80000000
```

## board/renesas/rzg2l-dev/Kconfig
```kconfig
if TARGET_RZG2L_DEV

config SYS_SOC
	default "rmobile"

config SYS_BOARD
	default "rzg2l-dev"

config SYS_VENDOR
	default "renesas"

config SYS_CONFIG_NAME
	default "rzg2l-dev"

endif

if TARGET_SMARC_RZG2L

config SYS_SOC
	default "rmobile"

config SYS_BOARD
	default "rzg2l-dev"

config SYS_VENDOR
	default "renesas"

config SYS_CONFIG_NAME
	default "aaasmarc-rzg2l"

endif
```
